## conf/layer.conf
```bitbake
# We have a conf and classes directory, add to BBPATH
BBPATH .= ":${LAYERDIR}"

# We have recipes-* directories, add to BBFILES
BBFILES += "${LAYERDIR}/recipes-*/*/*.bb \
            ${LAYERDIR}/recipes-*/*/*.bbappend"

BBFILE_COLLECTIONS += "meta-mybeagle"
BBFILE_PATTERN_meta-mybeagle = "^${LAYERDIR}/"
BBFILE_PRIORITY_meta-mybeagle = "7"

LAYERDEPENDS_meta-mybeagle = "core"
LAYERSERIES_COMPAT_meta-mybeagle = "scarthgap"
```

## conf/machine/mybeaglebone.conf
```bitbake
#@TYPE: Machine
#@NAME: My Custom BeagleBone Black
#@DESCRIPTION: Custom BeagleBone Black configuration based on TI BSP

# Inherit from the TI beaglebone machine
require conf/machine/beaglebone.conf

# Custom settings
MACHINE_FEATURES += "wifi bluetooth"

# Custom device tree (example)
# KERNEL_DEVICETREE = "am335x-boneblack.dtb am335x-boneblack-myboard.dtb"

# Add custom kernel modules or drivers
# MACHINE_EXTRA_RRECOMMENDS += "kernel-module-mydriver"

# Custom image features
# IMAGE_FEATURES += "myfeature"
```
